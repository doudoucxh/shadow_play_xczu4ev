## project_puppet/deploy/yolo_pose9/sd_candidate/image.its
```
/dts-v1/;
/ {
    description = "Shadow DPU camera reset fix";
    #address-cells = <1>;
    images {
        kernel-1 {
            description = "Linux kernel";
            data = /incbin/("kernel.gz");
            type = "kernel"; arch = "arm64"; os = "linux";
            compression = "gzip"; load = <0x00200000>; entry = <0x00200000>;
            hash-1 { algo = "sha256"; };
        };
        fdt-system-top.dtb {
            description = "Flattened Device Tree blob";
            data = /incbin/("system.dtb");
            type = "flat_dt"; arch = "arm64"; compression = "none";
            hash-1 { algo = "sha256"; };
        };
        ramdisk-1 {
            description = "petalinux-image-minimal";
            data = /incbin/("rootfs.cpio.gz");
            type = "ramdisk"; arch = "arm64"; os = "linux"; compression = "none";
            hash-1 { algo = "sha256"; };
        };
    };
    configurations {
        default = "conf-system-top.dtb";
        conf-system-top.dtb {
            description = "1 Linux kernel, FDT blob, ramdisk";
            kernel = "kernel-1"; fdt = "fdt-system-top.dtb"; ramdisk = "ramdisk-1";
        };
    };
};
```
